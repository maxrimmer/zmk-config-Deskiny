## config/boards/shields/Deskiny/Kconfig.defconfig
```kconfig
if SHIELD_DESKINY_LEFT

config SHIELD_DESKINY_NAME
    default "DESKINY"

config ZMK_SPLIT_ROLE_CENTRAL
    default y

endif 

if SHIELD_DESKINY_LEFT || SHIELD_DESKINY_RIGHT

    config ZMK_SPLIT
        default y

endif 
```
